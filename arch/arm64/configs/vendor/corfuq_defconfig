## drivers/backlight/sm5350/Kconfig
```kconfig
config LEDS_SM5350
	tristate "LED support for SM5350"
	depends on LEDS_CLASS
	depends on I2C
	help
	  This option enables support for LEDs connected to SM5350.
```

## drivers/gud/Kconfig
```kconfig
#
# Trustonic drivers configuration
#

config TRUSTONIC_TEE
    tristate "Trustonic TEE Driver"
    depends on ARM64
    default n
    ---help---
      Enable Trustonic TEE support

config RSU_SELECT_INTERNAL_CLOCK
    bool "Use internal clock for qcom_seecom"
    depends on TRUSTONIC_TEE
    default n
    ---help---
      Set for platforms that use internal clock for qcom_seecom
```

## drivers/input/misc/rbs_fod_mmi/Kconfig
```kconfig
config RBS_FOD_MMI
	tristate "rbs fod mmi"
	default n
	help
	 Say Y here if you wish to include support
	 If unsure, say N.

config EGIS_PANEL_NOTIFICATIONS
	bool "panel notification support"
	default n
	depends on RBS_FOD_MMI
	help
	 Say Y here if you wish to include support
         sysfs.
	 If unsure, say N.
```

## drivers/input/misc/silead_fps_mmi/Kconfig
```kconfig
config INPUT_SILEAD_FPS_MMI
	tristate "SILEAD fingerprint sensor MMI"
	default n
	help
	 Say Y here if you wish to include support for MMI SILEAD finger print sensor.
	 If unsure, say N.
```

## drivers/input/touchscreen/focaltech_0flash_v2_mmi/Kconfig
```kconfig
config INPUT_FOCALTECH_0FLASH_MMI_ENABLE_DOUBLE_TAP
	bool "Enable Double Tap"
	depends on INPUT_TOUCHSCREEN_FOCALTECH_0FLASH_MMI
	default n
	help
	  Say Y here to enable double tap functionality on Focaltech 0flash touch panel.
	  If unsure, say N.

config INPUT_FOCALTECH_0FLASH_MMI_NOTIFY_TOUCH_STATE
	bool "Notify Touch State"
	depends on INPUT_TOUCHSCREEN_FOCALTECH_0FLASH_MMI
	default n
	help
	  Say Y here to enable notification of touch state on Focaltech 0flash touch panel.
	  If unsure, say N.

config INPUT_FOCALTECH_ESD_EN
	bool "Enable ESD"
	depends on INPUT_TOUCHSCREEN_FOCALTECH_0FLASH_MMI
	default n
	help
	  Say Y here to enable Electrostatic Discharge (ESD) support on Focaltech 0flash touch panel.
	  If unsure, say N.

config INPUT_FOCALTECH_PANEL_NOTIFICATIONS
	bool "Enable Panel Notifications"
	depends on INPUT_TOUCHSCREEN_FOCALTECH_0FLASH_MMI
	default n
	help
	  Say Y here to enable panel notifications on Focaltech 0flash touch panel.
	  If unsure, say N.

config INPUT_FOCALTECH_DEBUG_EN
	bool "Enable Debug"
	depends on INPUT_TOUCHSCREEN_FOCALTECH_0FLASH_MMI
	default n
	help
	  Say Y here to enable debugging features on Focaltech 0flash touch panel.
	  If unsure, say N.

config INPUT_FOCALTECH_PINCTRL_EN
	bool "Enable Pin Control"
	depends on INPUT_TOUCHSCREEN_FOCALTECH_0FLASH_MMI
	default n
	help
	  Say Y here to enable Pin Control features on Focaltech 0flash touch panel.
	  If unsure, say N.

config FOCALTECH_LAST_TIME
	bool "Enable Last Time Feature"
	depends on INPUT_TOUCHSCREEN_FOCALTECH_0FLASH_MMI
	default n
	help
	  Say Y here to enable the last time feature on Focaltech 0flash touch panel.
	  If unsure, say N.

config INPUT_TOUCHSCREEN_FOCALTECH_0FLASH_MMI
	tristate "Focaltech 0flash Touchscreen MMI"
	depends on INPUT_TOUCHSCREEN
	default n
	help
	  Say Y here to build the Focaltech 0flash Touchscreen MMI driver as a module.
	  If unsure, say N.
```

## drivers/input/touchscreen/focaltech_touch_v3/Kconfig
```kconfig
#
# Focaltech Touchscreen driver configuration
#

config TOUCHSCREEN_FTS_V3
    tristate "Focaltech Touchscreen v3"
    default n
    help
      Say Y here if you have Focaltech touch panel.
      If unsure, say N.

config INPUT_FOCALTECH_V3_MMI_IC_NAME_FT3681
        bool "Focaltech V3 Chip FT3681"
        depends on TOUCHSCREEN_FTS_V3
        default n
        help
          Say Y here to enable support for Focaltech FT3681 touch panel.
          If unsure, say N.

config INPUT_FOCALTECH_V3_MMI_ENABLE_DOUBLE_TAP
        bool "Enable Double Tap"
        depends on INPUT_FOCALTECH_V3_MMI_IC_NAME_FT3681
        default n
        help
          Say Y here to enable double tap functionality on Focaltech V3 touch panel.
          If unsure, say N.

config INPUT_FOCALTECH_V3_MMI_ENABLE_PALM
        bool "Enable Palm Sensing"
        depends on INPUT_FOCALTECH_V3_MMI_IC_NAME_FT3681
        default n
        help
          Say Y here to enable palm sensing functionality on Focaltech V3 touch panel.
          If unsure, say N.

config INPUT_FOCALTECH_V3_MMI_PEN_NOTIFIER
        bool "Enable Pen Notifier"
        depends on INPUT_FOCALTECH_V3_MMI_IC_NAME_FT3681
        default n
        help
          Say Y here to enable pen notifier functionality on Focaltech V3 touch panel.
          If unsure, say N.
```

## drivers/input/touchscreen/focaltech_v2_mmi/Kconfig
```kconfig
#
# Focaltech Touchscreen driver configuration
#

config TOUCHSCREEN_FOCALTECH_V2_MMI
	tristate "Moto Focaltech Touchscreen"
	depends on I2C
	default n
	help
	  Say Y here if you have Moto Focaltech touch panel.
	  If unsure, say N.

config INPUT_FOCALTECH_MMI_ENABLE_DOUBLE_TAP
	bool "Moto Focaltech Double tap"
	depends on TOUCHSCREEN_FOCALTECH_V2_MMI
	default n
	help
	  Say Y here to enable support for double tap functionality on Focaltech touch panel.
	  If unsure, say N.

config INPUT_FOCALTECH_MMI_ENABLE_PALM
	bool "Moto Focaltech Palm"
	depends on TOUCHSCREEN_FOCALTECH_V2_MMI
	default n
	help
	  Say Y here to enable support for Palm functionality on Focaltech touch panel.
	  If unsure, say N.

config INPUT_FOCALTECH_MMI_PEN_NOTIFIER
	bool "Moto Focaltech Pen"
	depends on TOUCHSCREEN_FOCALTECH_V2_MMI
        default n
        help
          Say Y here to enable support for Pen functionality on Focaltech touch panel.
          If unsure, say N.
```

## drivers/input/touchscreen/focaltech_v3_mmi/Kconfig
```kconfig
config TOUCHSCREEN_FOCALTECH_V3_MMI
        tristate "Moto Focaltech Touchscreen"
        depends on I2C
        default n
        help
          Say Y here if you have Moto Focaltech touch panel.
          If unsure, say N.

config INPUT_FOCALTECH_MMI_IC_NAME_FT3519
        bool "Focaltech Chip FT3519"
        depends on INPUT_TOUCHSCREEN_MMI && TOUCHSCREEN_FOCALTECH_V3_MMI
        default n
        help
          Say Y here to enable support for Focaltech FT3519 touch panel.
          If unsure, say N.

config INPUT_FOCALTECH_MMI_IC_NAME_FT3518U
        bool "Focaltech Chip FT3518U"
        depends on INPUT_TOUCHSCREEN_MMI && TOUCHSCREEN_FOCALTECH_V3_MMI
        default n
        help
          Say Y here to enable support for Focaltech FT3518U touch panel.
          If unsure, say N.

config INPUT_FOCALTECH_MMI_ENABLE_DOUBLE_TAP
        bool "Enable Double Tap"
        depends on INPUT_TOUCHSCREEN_MMI && TOUCHSCREEN_FOCALTECH_V3_MMI
        default n
        help
          Say Y here to enable double tap functionality on Focaltech touch panel.
          If unsure, say N.

config INPUT_FTS_TEST_SUPPORT
        bool "Focaltech Test Support"
        depends on INPUT_TOUCHSCREEN_MMI && TOUCHSCREEN_FOCALTECH_V3_MMI
        default n
        help
          Say Y here to enable support for Focaltech touchscreen test functionality.
          If unsure, say N.

config INPUT_FTS_MTK_V2_MMI_IC_NAME_FT3519
        bool "Focaltech Chip FT3519 for Test Support"
        depends on INPUT_FTS_TEST_SUPPORT && TOUCHSCREEN_FOCALTECH_V3_MMI
        default n
        help
          Say Y here to enable support for Focaltech FT3519 in test mode.
          If unsure, say N.
```

## drivers/input/touchscreen/ili9882_mmi/Kconfig
```kconfig
#
# Ilitek touchscreen driver configuration
#
config TOUCHSCREEN_ILITEK_CHIPSET_MMI
	tristate "TOUCHSCREEN ILITEK CHIPSET"
	help
	  Say Y here if you have a ILITEK CHIPSET touchscreen.
	  ILITEK controllers are multi touch controllers which can
	  report 10 touches at a time.

	  If unusre, say N.

config ILITEK_DOUBLE_TAP
	bool "Double tap"
	depends on TOUCHSCREEN_ILITEK_CHIPSET_MMI
	default n
	help
	  Say Y here if you want to have Double tap support.

	  If unsure, say N.

config ILITEK_PANEL_NOTIFICATIONS
	bool "Panel Notifications"
	depends on TOUCHSCREEN_ILITEK_CHIPSET_MMI
	default n
	help
	  Say Y here if you want to have panel notification support.

	  If unsure, say N.

config ILITEK_TOUCH_STATE
	bool "Check Touch State"
	depends on TOUCHSCREEN_ILITEK_CHIPSET_MMI
	default n
	help
	  Say Y here if you want to have touch state check support.

	  If unsure, say N.

config ILITEK_RESUME_BY_DDI
	bool "Resume by Display Driver Integration"
	depends on TOUCHSCREEN_ILITEK_CHIPSET_MMI
	default n
	help
	  Say Y here if you want to have resume by display driver support.

	  If unsure, say N.

config ILITEK_FW_PANEL
	bool "Panel based firmware checks"
	depends on TOUCHSCREEN_ILITEK_CHIPSET_MMI
	default n
	help
	  Say Y here if you want to firmware by panel support.

	  If unsure, say N.

config ILITEK_SUSPEND_PWROFF
	bool "Suspend Power-off"
	depends on TOUCHSCREEN_ILITEK_CHIPSET_MMI
	default n
	help
	  Say Y here if you want to have suspend power off support.

	  If unsure, say N.

config ILITEK_CHARGER
	bool "Charger mitigation"
	depends on TOUCHSCREEN_ILITEK_CHIPSET_MMI
	default n
	help
	  Say Y here if you want to charger mitigation support.

	  If unsure, say N.

config ILITEK_ESD
	bool "ESD mitigation"
	depends on TOUCHSCREEN_ILITEK_CHIPSET_MMI
	default n
	help
	  Say Y here if you want to support ESD mitigation.

	  If unsure, say N.

config ILITEK_GESTURE
	bool "Gestures"
	depends on TOUCHSCREEN_ILITEK_CHIPSET_MMI
	default n
	help
	  Say Y here if you want to support gestures.

	  If unsure, say N.

config ILITEK_PANEL_GESTURE
	bool "Gestures by panel"
	depends on TOUCHSCREEN_ILITEK_CHIPSET_MMI
	default n
	help
	  Say Y here if you want to support gesture by panel.

	  If unsure, say N.
```

## drivers/input/touchscreen/nova_0flash_mmi/Kconfig
```kconfig
#
# Novatek NT36xxx touchscreen driver configuration
#
config TOUCHSCREEN_NT36xxx_HOSTDL_SPI_MMI
	tristate "Moto Novatek NT36xxx host download SPI driver"
	default n
	help
	  Say Y here if you have a Moto Novatek NT36xxx no flash touchscreen connected
	  to your system by SPI bus.

	  If unsure, say N.

config INPUT_NOVA_0FLASH_MMI_ENABLE_DOUBLE_TAP
	bool "Moto Novatek NT36xxx Double tap"
	depends on TOUCHSCREEN_NT36xxx_HOSTDL_SPI_MMI
	default n
	help
	  Say Y here if you want to have Double tap support on Moto Novatek NT36xxx.

	  If unsure, say N.

config INPUT_NOVA_PANEL_NOTIFICATIONS
	bool "Moto Novatek NT36xxx panel notification"
	depends on TOUCHSCREEN_NT36xxx_HOSTDL_SPI_MMI
	default n
	help
	  Say Y here if you want to have panel notification support on Moto Novatek NT36xxx.

	  If unsure, say N.

config NOVA_ESD_ENABLE
        bool "Moto Novatek NT36xxx ESD Detection"
        depends on TOUCHSCREEN_NT36xxx_HOSTDL_SPI_MMI
        default n
        help
          Say Y here if you want to have ESD Detection support on Moto Novatek NT36xxx.

          If unsure, say N.

config INPUT_NOVA_0FLASH_MMI_NOTIFY_TOUCH_STATE
        bool "Moto Novatek NT36xxx Notify Touch State"
        depends on TOUCHSCREEN_NT36xxx_HOSTDL_SPI_MMI
        default n

config INPUT_NOVA_CHIP_VER_1
        bool "Moto Novatek NT36xxx Chip Ver 1"
        depends on TOUCHSCREEN_NT36xxx_HOSTDL_SPI_MMI
        default n

config NOVA_LCM_FAST_LIGHTUP
        bool "Moto Novatek NT36xxx LCM Fast lightup"
        depends on TOUCHSCREEN_NT36xxx_HOSTDL_SPI_MMI
        default n

config INPUT_NOVA_0FLASH_MMI_STYLUS_PALM
        bool "Moto Novatek NT36xxx Stylus palm"
        depends on TOUCHSCREEN_NT36xxx_HOSTDL_SPI_MMI
        default n

config INPUT_NOVA_0FLASH_MMI_STYLUS_PALM_RANGE
        bool "Moto Novatek NT36xxx Stylus palm range"
        depends on TOUCHSCREEN_NT36xxx_HOSTDL_SPI_MMI
        default n

config INPUT_NOVA_0FLASH_MMI_PEN_NOTIFIER
        bool "Moto Novatek NT36xxx Stylus pen notifier"
        depends on TOUCHSCREEN_NT36xxx_HOSTDL_SPI_MMI
        default n

config INPUT_NOVA_EDGE_SUPPRESSION
        bool "Moto Novatek NT36xxx Stylus edge suppression"
        depends on TOUCHSCREEN_NT36xxx_HOSTDL_SPI_MMI
        default n
```

## drivers/misc/awinic/sarsensor/Kconfig
```kconfig
config AW96XX_POWER_SUPPLY_ONLINE
	bool "AW96XX Power Supply Online"
	default n
	help
	  Say Y here to enable the AW96XX power supply online feature.
	  If unsure, say N.

config AW96XX_SAR
	tristate "AW96XX SAR Driver"
	depends on INPUT
	default n
	help
	  Say Y here to build the AW96XX SAR driver as a module.
	  If unsure, say N.
```

## drivers/misc/pen/Kconfig
```kconfig
config MISC_BU520XX
        tristate "BU520XX hall sensor driver"
        help
          Say Y here if you have BU520XX sensor
          chip in your system.

          If unsure, say N.

          To compile this driver as a module, choose M here: the
          module will be called bu520xx_pen.
```

## drivers/misc/sx937x/Kconfig
```kconfig
config SX937X_CAPSENSE
	tristate "Semtech high performance CAP sensor"
	default n
	help
	The SX9367x is a capacitive specific absorption rate (SAR) controller.

config SX937X_CAPSENSE_USB_CAL
	bool "Semtech SX937x USB Calibration"
	depends on SX937X_CAPSENSE
	default n
	help
	Say Y to enable USB calibration.

config SX937X_CAPSENSE_USE_POWER_SUPPLY_ONLINE
	bool "Use POWER_SUPPLY_PROP_ONLINE instead of POWER_SUPPLY_PROP_PRESENT"
	depends on SX937X_CAPSENSE
	default n
	help
	Say Y to use the POWER_SUPPLY_PROP_ONLINE prop instead of POWER_SUPPLY_PROP_PRESENT.

config SX937X_CAPSENSE_FLIP_CAL
	bool "Flip register values for SX937X"
	depends on SX937X_CAPSENSE
	default n
	help
	Say Y here if you want to flip register calibration values.
```

## drivers/nfc/sn1xx/Kconfig
```kconfig
config NFC_SN1XX
        tristate "SN1XX NFC"
        default n
        help
         Say Y here if you have a sn1xx nfc compatible
         device connected.

         This driver can also be built as a module.  If so, the module
         will be called nfc_i2c.
```

## drivers/nfc/st21nfc/Kconfig
```kconfig
config NFC_ST21NFC
	tristate "ST21NFC"
	---help---
	  STMicroelectronics ST21NFC core driver. It implements the chipset
	  HCI logic and hooks into the NFC kernel APIs. Physical layers will
	  register against it.
```

## drivers/power/Kconfig
```kconfig
# SPDX-License-Identifier: GPL-2.0-only
source "drivers/power/avs/Kconfig"
source "drivers/power/reset/Kconfig"
source "drivers/power/supply/Kconfig"
source "drivers/power/qpnp_adaptive_charge/Kconfig"
source "drivers/power/mmi-smbcharger-iio/Kconfig"
source "drivers/power/bq2589x_chg_mmi/Kconfig"
source "drivers/power/cw2217b_fg_mmi/Kconfig"
source "drivers/power/mmi_discrete_charger/Kconfig"
source "drivers/power/mmi_charger/Kconfig"
source "drivers/power/rt9426a_fg_mmi/Kconfig"
source "drivers/power/sd77426_fg_mmi/Kconfig"
source "drivers/power/sm5602_fg_mmi/Kconfig"
source "drivers/power/sgm4154x_chg_mmi/Kconfig"
source "drivers/power/mmi_parallel_charger_iio/Kconfig"
source "drivers/power/mmi_sc8549/Kconfig"
source "drivers/power/mmi_discrete_turbo_charger/Kconfig"
source "drivers/power/bq2597x_mmi_iio/Kconfig"
```

## drivers/power/bq25980_mmi_iio/Kconfig
```kconfig
config BQ25980_MMI_IIO_CHARGER
        tristate "BQ25980 MMI IIO Charger"
        default n
        help
         Say Y here if you have a bq25980 compatible
         device connected.

         This driver can also be built as a module.  If so, the module
         will be called bq25980_mmi_iio.

config MMI_BQ25980_BULK_READ
	bool "MMI BQ25980 Bulk Read"
	default n
	help
	  Say Y here to enable the MMI BQ25980 bulk read feature.
	  If unsure, say N.
```

## drivers/power/mmi-smbcharger-iio/Kconfig
```kconfig
config MMI_SMBCHARGER_IIO
        tristate "MMI SMBCHARGER IIO"
        default n
        help
         Say Y here if you have a mmi smbcharger iio compatible
         device connected.

         This driver can also be built as a module.  If so, the module
         will be called mmi-smbcharger-iio.
```
