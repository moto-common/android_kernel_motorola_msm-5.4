## drivers/power/mmi_parallel_charger_iio/Kconfig
```kconfig
config MMI_PARALLEL_CHARGER_IIO
        tristate "MMI Parallel Charger IIO"
        default n
        help
         Say Y here if you have a mmi parallel charger iio compatible
         device connected.

         This driver can also be built as a module.  If so, the module
         will be called mmi_parallel_charger_iio.
```

## drivers/power/mmi_sc8549/Kconfig
```kconfig
config MMI_SC8549
        tristate "MMI SC8549 PD"
        default n
        help
         Say Y here if you have a mmi sc8549 compatible
         device connected.

         This driver can also be built as a module.  If so, the module
         will be called mmi_sc8549.
```

## drivers/power/rt9426a_fg_mmi/Kconfig
```kconfig
config RT9426A_FG
        tristate "RT9426A Fuel Guage driver"
        default n
        help
         Say Y here if you have a RT9426A compatible
         device connected.

         This driver can also be built as a module.  If so, the module
         will be called rt9426a_fg_mmi.
```

## drivers/power/sd77426_fg_mmi/Kconfig
```kconfig
config SD77426_FG
        tristate "SD77426 Fuel Guage driver"
        default n
        help
         Say Y here if you have a SD77426 compatible
         device connected.

         This driver can also be built as a module.  If so, the module
         will be called sd77426_fg_mmi.
```

## drivers/regulator/wl2868c/Kconfig
```kconfig
config REGULATOR_WL2868C
        tristate "WL2868C REGULATOR"
        default n
        help
         Say Y here if you have a WL2868C compatible
         device connected.

         This driver can also be built as a module.  If so, the module
         will be called wl2868c-regulator.
```

## drivers/sensors/Kconfig
```kconfig
# SPDX-License-Identifier: GPL-2.0-only
config SENSORS_CLASS
	tristate "Enable Sensors Class Driver Support"
	help
	  Add support for sensors class driver.
```
